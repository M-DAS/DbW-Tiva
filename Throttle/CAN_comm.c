#define PART_TM4C123GH6PM 1;

#include <stdint.h>
#include <stdbool.h>
#include "inc/tm4c123gh6pm.h"
#include "inc/hw_memmap.h"
#include "inc/hw_types.h"
#include "driverlib/sysctl.h"
#include "driverlib/interrupt.h"
#include "driverlib/gpio.h"
#include "driverlib/timer.h"
#include "driverlib/pin_map.h"
#include "driverlib/can.h"
#include "Pedal_ADC.h"
#include "Globals_and_Defines.h"
	
void CAN_Setup(void)
{
	tCANMsgObject sMsgObjectRx;

	SysCtlPeripheralEnable(SYSCTL_PERIPH_GPIOE);
	while(!SysCtlPeripheralReady(SYSCTL_PERIPH_GPIOE))
	{}

	GPIOPinConfigure(GPIO_PE4_CAN0RX);
	GPIOPinConfigure(GPIO_PE5_CAN0TX);
	GPIOPinTypeCAN(GPIO_PORTE_BASE, GPIO_PIN_4 | GPIO_PIN_5);
	SysCtlPeripheralEnable(SYSCTL_PERIPH_CAN0);
	while(!SysCtlPeripheralReady(SYSCTL_PERIPH_CAN0))
	{}

	CANInit(CAN0_BASE);
	CANBitRateSet(CAN0_BASE, SysCtlClockGet(), 250000);
	CANIntEnable(CAN0_BASE, CAN_INT_MASTER);
	IntEnable(INT_CAN0);
	CANEnable(CAN0_BASE);
	
	sMsgObjectRx.ui32MsgID = 0;
	sMsgObjectRx.ui32MsgIDMask = 0;
	sMsgObjectRx.ui32Flags = MSG_OBJ_RX_INT_ENABLE | MSG_OBJ_USE_ID_FILTER;
	sMsgObjectRx.ui32MsgLen = 8;
	CANMessageSet(CAN0_BASE, 2, &sMsgObjectRx, MSG_OBJ_TYPE_RX);
}

void CAN0_Handler(void)
{
	uint32_t int_status;
	uint8_t data_array[8];
	tCANMsgObject sMsgObjectRx;
	sMsgObjectRx.pui8MsgData = data_array;
	
	int_status = CANIntStatus(CAN0_BASE, CAN_INT_STS_CAUSE);  
	CANStatusGet(CAN0_BASE, CAN_STS_CONTROL);
	
	if (int_status == 0x2)   //interrupt was generated by receive object
	{
		CANMessageGet(CAN0_BASE, 2, &sMsgObjectRx, true);   //get received data
		g_new_CAN_data = true;
		switch(sMsgObjectRx.ui32MsgID)
		{
			case estop_address:
					enableDbW = false;
					PF2 = 0x00;
					PF1 = 0x02;
			break;
			case dsrc_address:
				dsrc = !dsrc;
			break;
			case throttle_board_address:
				if (data_array[0] == 0x01 ||data_array[0] == 0x02) 		//This is joystick ID 0x01; This is PX2 ID 0x02;
				{
				int eventType = data_array[1];
				if(eventType == 0x00)
					Throttle_Command = (data_array[2]<<8) + data_array[3];	
				}	
				break;
		}		
	}
}
void Send_Throttle_Voltage(void)
{
	tCANMsgObject sMsgObjectTx;
	uint8_t BufferOut[3] = {0x00, 0x00, 0x00};
	uint32_t throttle_pos;
	throttle_pos = get_throttle_input(1);
	if (throttle_pos < 760) 
		throttle_pos = 745;
	if (throttle_pos > 2550) 
		throttle_pos = 2729;
	throttle_pos = (52848 * throttle_pos) - 39321600;
	throttle_pos = throttle_pos >> 20;
	BufferOut[0] = 0x01;  							//SRC ID
	BufferOut[1] = throttle_pos >> 8;   //MSB BYTE
	BufferOut[1] &= 0x00FF;							
	BufferOut[2] = throttle_pos;				//LSB BYTE
	BufferOut[2] &= 0x00FF;
	
	//Configure transmit of message object.
	sMsgObjectTx.ui32MsgID = feedback_address;
	sMsgObjectTx.ui32Flags = 0;
	sMsgObjectTx.ui32MsgLen = 3;
	sMsgObjectTx.pui8MsgData = BufferOut;
	
	//Send out data on CAN
	CANMessageSet(CAN0_BASE, 3, &sMsgObjectTx, MSG_OBJ_TYPE_TX);
}

void send_Estop(void)
{		
	  tCANMsgObject sMsgObjectTx;
	  uint8_t pui8BufferOut[8] = {0x00,0x00,0x00,0x00,0x00,0x00,0x00,0x00};

		sMsgObjectTx.ui32MsgID = estop_address;
		sMsgObjectTx.ui32Flags = 0;
		sMsgObjectTx.ui32MsgLen = 8;
		sMsgObjectTx.pui8MsgData = pui8BufferOut;
		
		CANMessageSet(CAN0_BASE, 8, &sMsgObjectTx, MSG_OBJ_TYPE_TX);
}
