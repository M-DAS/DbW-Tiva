#define PART_TM4C123GH6PM 1;

#include <stdint.h>
#include <stdbool.h>
#include "inc/tm4c123gh6pm.h"
#include "inc/hw_memmap.h"
#include "inc/hw_types.h"
#include "driverlib/sysctl.h"
#include "driverlib/interrupt.h"
#include "driverlib/gpio.h"
#include "driverlib/timer.h"
#include "driverlib/pin_map.h"
#include "driverlib/can.h"
#include "DriveByWireIO.h"
#include "Steering_Actuator.h"
#include "Globals_and_Defines.h"
	
int average = 0;

void CAN_Setup(void)
{
	tCANMsgObject sMsgObjectRx;

	SysCtlPeripheralEnable(SYSCTL_PERIPH_GPIOE);
	while(!SysCtlPeripheralReady(SYSCTL_PERIPH_GPIOE))
	{}

	GPIOPinConfigure(GPIO_PE4_CAN0RX);
	GPIOPinConfigure(GPIO_PE5_CAN0TX);
	GPIOPinTypeCAN(GPIO_PORTE_BASE, GPIO_PIN_4 | GPIO_PIN_5);
	SysCtlPeripheralEnable(SYSCTL_PERIPH_CAN0);
	while(!SysCtlPeripheralReady(SYSCTL_PERIPH_CAN0))
	{} 
		
	CANInit(CAN0_BASE);
	CANBitRateSet(CAN0_BASE, SysCtlClockGet(), 250000);
	CANIntEnable(CAN0_BASE, CAN_INT_MASTER);
	IntEnable(INT_CAN0);
	CANEnable(CAN0_BASE);
		
	sMsgObjectRx.ui32MsgID = 0;
	sMsgObjectRx.ui32MsgIDMask = 0;
	sMsgObjectRx.ui32Flags = MSG_OBJ_RX_INT_ENABLE | MSG_OBJ_USE_ID_FILTER;
	sMsgObjectRx.ui32MsgLen = 8;
	CANMessageSet(CAN0_BASE, 2, &sMsgObjectRx, MSG_OBJ_TYPE_RX);
}

void send_Estop()
{		
	  tCANMsgObject sMsgObjectTx;
	  uint8_t pui8BufferOut[8] = {0x00,0x00,0x00,0x00,0x00,0x00,0x00,0x00};

		sMsgObjectTx.ui32MsgID = estop_address;
		sMsgObjectTx.ui32Flags = 0;
		sMsgObjectTx.ui32MsgLen = 8;
		sMsgObjectTx.pui8MsgData = pui8BufferOut;
		
		CANMessageSet(CAN0_BASE, 8, &sMsgObjectTx, MSG_OBJ_TYPE_TX);
}

void CAN0_Handler(void)
{
	uint32_t int_status;
	uint8_t data_array[8];
	uint8_t srcId;
	uint8_t eventType;
	tCANMsgObject sMsgObjectRx;
	sMsgObjectRx.pui8MsgData = data_array;

	int_status = CANIntStatus(CAN0_BASE, CAN_INT_STS_CAUSE);  
	CANStatusGet(CAN0_BASE, CAN_STS_CONTROL);
	
	if (int_status == 0x2)   //interrupt was generated by receive object
	{
		CANMessageGet(CAN0_BASE, 2, &sMsgObjectRx, true);   //get received data
		g_new_CAN_data = true;
		switch(sMsgObjectRx.ui32MsgID)
		{
			case estop_address:
					enableDbW = false;
					PF2 = 0x00;
					PF1 = 0x02;
			break;
			case dsrc_address:
				dsrc = !dsrc;
			break;
			case TorqueInOut_Address:
			if ((((data_array[2] > 0x80 && data_array[2] < 0xF0))&& data_array[3] == 0x00)||//RIGHT INTERVAL 
					(data_array[2] > 0x30 && data_array[2] < 0x80&& data_array[3] == 0xFF)) 			//LEFT INTERVAL
					{
						average++;
						if (average > 3)
						{
							average = 0;
							zero_steering_act();
							enableDbW = false;
							send_Estop();
						}
					}
			else
			{
				average = 0;
			}		
			break;
			case steering_board_address:
				if(enableDbW == true)
				{
					uint8_t x = 0;
					CAN_Position = 0;
					CAN_Speed = 0x75;

					
					srcId = data_array[0];
					eventType = data_array[1];
					
					if(srcId == 0x01)
					{
						if(eventType == 0x00)
						{
							joyData = true;
							CAN_Position = (data_array[2]<<8) + data_array[3];
						}
					}
					else if(srcId == 0x02)
					{
						if(eventType == 0x00)
						{
							px2Data = true;
							CAN_Speed = data_array[6];
							for (x = 4; x > 0; x--)
								CAN_Position +=data_array[x]<<(8*(x-1));
						}
					}
				}
			break;
		}
	}
}


